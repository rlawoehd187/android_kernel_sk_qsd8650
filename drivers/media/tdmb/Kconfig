## drivers/media/tdmb/Kconfig
```kconfig
menu "TDMB support"

config TDMB_T3700
	tristate "INCTECH T3700 TDMB Chip Support"
	depends on I2C && MACH_QSD8X50_S1
	help
	  Enable this driver to get read/write support to INCTECH TDMB,
	  

endmenu
```

## drivers/mtd/panic_log/Kconfig
```kconfig
# drivers/mtd/panic_log/Kconfig

menu "Low level nand devices for saved Panic Log"
	depends on MTD!=n

config PANIC_LOG_SAVE
	bool "Save the Panic log"
	depends on PRINTK
	help
	  this feature to read/write nand page to be saved panic log ,
config PANIC_DISP_LOG
	bool "Display the Panic log"
	depends on PRINTK && PANIC_LOG_SAVE
	help
	  Display the panic log	  
endmenu
```
